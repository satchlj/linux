## Documentation/devicetree/bindings/sound/apple,t6050-dpaudio.yaml
```yaml
# SPDX-License-Identifier: (GPL-2.0-only OR BSD-2-Clause)
%YAML 1.2
---
$id: http://devicetree.org/schemas/sound/apple,t6050-dpaudio.yaml#
$schema: http://devicetree.org/meta-schemas/core.yaml#

title: Apple T6050 DisplayPort audio

maintainers:
  - Satya Benson <satya@benson.earth>

description: |
  The DisplayPort audio interface (DPA) of one T6050 display pipe. It has no
  application-processor registers. Unlike earlier SoCs, whose DPAs are fed by
  the SIO coprocessor, every T6050 display pipe has its own audio DMA
  controller, which the application processor drives. The display
  processor's audio service sets up the link; the graph connects this
  interface to port 0 of that display processor.

select:
  properties:
    compatible:
      contains:
        const: apple,t6050-dpaudio
  required:
    - compatible

properties:
  compatible:
    items:
      - const: apple,t6050-dpaudio
      - const: apple,dpaudio

  dmas:
    maxItems: 1

  dma-names:
    const: tx

  ports:
    $ref: /schemas/graph.yaml#/properties/ports
    properties:
      port@0:
        $ref: /schemas/graph.yaml#/properties/port
        description: Connection to the display processor's audio service.
    required:
      - port@0

required:
  - compatible
  - dmas
  - dma-names
  - ports

additionalProperties: false

examples:
  - |
    audio-controller {
        compatible = "apple,t6050-dpaudio", "apple,dpaudio";
        dmas = <&admac_dispext1 0>;
        dma-names = "tx";

        ports {
            #address-cells = <1>;
            #size-cells = <0>;

            port@0 {
                reg = <0>;
                endpoint {
                    remote-endpoint = <&dcpext1_audio>;
                };
            };
        };
    };
```
